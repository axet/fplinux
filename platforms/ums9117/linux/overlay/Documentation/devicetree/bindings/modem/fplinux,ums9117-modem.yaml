## platforms/ums9117/linux/overlay/Documentation/devicetree/bindings/modem/fplinux,ums9117-modem.yaml
```yaml
# SPDX-License-Identifier: GPL-2.0-only
%YAML 1.2
---
$id: http://devicetree.org/schemas/modem/fplinux,ums9117-modem.yaml#
$schema: http://devicetree.org/meta-schemas/core.yaml#

title: UMS9117 cellular DSP loader

maintainers:
  - FPLinux contributors <313246064+fplinux-dev@users.noreply.github.com>

description: |
  Loads the stock GSM and LTE CEVA layer-1 images into fixed physical regions.
  Both load regions must be excluded from System RAM. The shared page holds the
  DSP ready magic and the optional NV calibration word. Clock/reset and mailbox
  access are opt-in; probing never starts the DSP on its own.

properties:
  compatible:
    const: fplinux,ums9117-modem

  reg:
    items:
      - description: GSM DSP load region
      - description: LTE DSP load region
      - description: LTE DSP shared page

  reg-names:
    items:
      - const: dsp-gsm
      - const: dsp-lte
      - const: dsp-shared

  firmware-name-gsm:
    $ref: /schemas/types.yaml#/definitions/string
    description: Firmware loader name of the GSM DSP image.

  firmware-name-lte:
    $ref: /schemas/types.yaml#/definitions/string
    description: Firmware loader name of the LTE DSP image.

  fplinux,gsm-header:
    $ref: /schemas/types.yaml#/definitions/uint32
    description: Bytes to skip before the GSM payload. Defaults to 0x80.

  fplinux,lte-header:
    $ref: /schemas/types.yaml#/definitions/uint32
    description: Bytes to skip before the LTE payload. Defaults to 0.

  fplinux,dsp-nv-stub:
    $ref: /schemas/types.yaml#/definitions/uint32
    description: |
      Initial value for the calibration/NV word written to the LTE shared page
      at +0xe00 before the DSP is released. The stock CP derives this word from
      a runtime NV lookup. The nv_stub sysfs attribute can override it.

  fplinux,aon-apb:
    $ref: /schemas/types.yaml#/definitions/phandle
    description: AON_APB syscon used for the opt-in DSP start sequence.

  fplinux,pmu-apb:
    $ref: /schemas/types.yaml#/definitions/phandle
    description: PMU_APB syscon used for the opt-in DSP start sequence.

  mboxes:
    maxItems: 1
    description: Mailbox channel used for the optional ready exchange.

  mbox-names:
    items:
      - const: dsp

required:
  - compatible
  - reg
  - reg-names

additionalProperties: false

examples:
  - |
    modem@80100000 {
        compatible = "fplinux,ums9117-modem";
        reg = <0x80100000 0x300000>, <0x80448000 0x2e4000>,
              <0x80447000 0x1000>;
        reg-names = "dsp-gsm", "dsp-lte", "dsp-shared";
        firmware-name-gsm = "ums9117/gsm_dsp.bin";
        firmware-name-lte = "ums9117/lte_dsp.bin";
        mbox-names = "dsp";
        mboxes = <&mailbox 3>;
    };
```

## platforms/ums9117/linux/overlay/drivers/modem/ums9117/Kconfig
```kconfig
# SPDX-License-Identifier: GPL-2.0-only
config UMS9117_MODEM
	bool "UMS9117 cellular DSP loader foundation"
	depends on ARCH_UMS9117 && OF
	select FW_LOADER
	select MAILBOX
	help
	  Load the stock GSM and LTE CEVA layer-1 images into their fixed
	  physical regions and expose load/status through sysfs. This is a
	  foundation only: it does not release DSP resets, configure clocks,
	  or implement a protocol stack. The DSP regions must be excluded
	  from System RAM in the device tree before enabling this option.
```
